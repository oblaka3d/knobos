## components/board_hal/Kconfig
```kconfig
choice KNOBOS_BOARD
    prompt "Плата knobos (пины + HAL дисплея)"
    default KNOBOS_BOARD_C3
    help
        Выбирает набор пинов из components/board_hal/include/boards/<board>.h
        и HAL-реализацию дисплея (hal_display_c3.c / hal_display_s3.c).

    config KNOBOS_BOARD_C3
        bool "ESP32-C3 — VIEWE UEDX24240013-MD50E (GC9A01 240x240)"

    config KNOBOS_BOARD_S3
        bool "ESP32-S3 — VIEWE UEDX46460015-MD50E (AMOLED CO5300 466x466)"
endchoice
```

## components/core/Kconfig
```kconfig
menu "Knobos dev"
config KNOBOS_DEV_WIFI_SSID
    string "Dev WiFi SSID"
    default ""
config KNOBOS_DEV_WIFI_PASS
    string "Dev WiFi password"
    default ""
endmenu
```

## sdkconfig.defaults
```kconfig
CONFIG_PARTITION_TABLE_CUSTOM=y
CONFIG_ESP_CONSOLE_USB_SERIAL_JTAG=y
CONFIG_COMPILER_OPTIMIZATION_SIZE=y
CONFIG_FREERTOS_HZ=1000
CONFIG_HTTPD_MAX_REQ_HDR_LEN=1024
CONFIG_LV_USE_QRCODE=y
```
